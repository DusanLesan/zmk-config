## config/boards/shields/kb/Kconfig.defconfig
```kconfig
if SHIELD_KB_DONGLE

config ZMK_KEYBOARD_NAME
	default "Kyria"

config ZMK_SPLIT_BLE_ROLE_CENTRAL
	default y

config ZMK_USB
	default y

endif

if SHIELD_KB_LEFT || SHIELD_KB_RIGHT || SHIELD_KB_DONGLE

config ZMK_SPLIT
	default y

config ZMK_BLE
	default y

endif
```

## config/boards/shields/kb/Kconfig.shield
```kconfig
config SHIELD_KB_LEFT
	def_bool $(shields_list_contains,kb_left)

config SHIELD_KB_RIGHT
	def_bool $(shields_list_contains,kb_right)

config SHIELD_KB_DONGLE
	def_bool $(shields_list_contains,kb_dongle)
```

## config/boards/shields/kyria/Kconfig.shield
```kconfig
config SHIELD_KB_LEFT
	def_bool $(shields_list_contains,kyria_left)

config SHIELD_KB_RIGHT
	def_bool $(shields_list_contains,kyria_right)

config SHIELD_KB_DONGLE
	def_bool $(shields_list_contains,kyria_dongle)
```

## config/boards/shields/kyria_rev3/Kconfig.defconfig
```kconfig
# Copyright (c) 2020 The ZMK Contributors
# SPDX-License-Identifier: MIT

if SHIELD_KYRIA_REV3_DONGLE

config ZMK_KEYBOARD_NAME
	default "Kyria Dongle"
	
config ZMK_SPLIT_BLE_ROLE_CENTRAL
	default y
	
config ZMK_USB
	default y

endif

if SHIELD_KYRIA_REV3_LEFT || SHIELD_KYRIA_REV3_RIGHT || SHIELD_KYRIA_REV3_DONGLE 

config ZMK_SPLIT
	default y

config ZMK_BLE
	default y
	
endif
```

## config/boards/shields/kyria_rev3/Kconfig.shield
```kconfig
config SHIELD_KYRIA_REV3_DONGLE
	def_bool $(shields_list_contains,kyria_rev3_dongle)

config SHIELD_KYRIA_P_LEFT
	def_bool $(shields_list_contains,kyria_p_left)

config SHIELD_KYRIA_P_RIGHT
	def_bool $(shields_list_contains,kyria_p_right)
```
