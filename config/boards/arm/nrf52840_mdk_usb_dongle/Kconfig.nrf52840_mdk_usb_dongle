## config/boards/arm/nrf52840_mdk_usb_dongle/Kconfig.nrf52840_mdk_usb_dongle
```kconfig
config BOARD_NRF52840_MDK_USB_DONGLE
	select ZMK_BOARD_COMPAT if BOARD_NRF52840_MDK_USB_DONGLE_NRF52840_ZMK
```

## config/boards/arm/nrf52840_mdk_usb_dongle/board.yml
```yaml
board:
  extend: nrf52840_mdk_usb_dongle
  variants:
    - name: zmk
      qualifier: nrf52840
```

## config/boards/arm/nrf52840_mdk_usb_dongle/nrf52840_mdk_usb_dongle_nrf52840_zmk_defconfig
```kconfig
CONFIG_ARM_MPU=y
CONFIG_HW_STACK_PROTECTION=y
CONFIG_GPIO=y
CONFIG_USB_DEVICE_REMOTE_WAKEUP=n
CONFIG_ZMK_BLE=y
CONFIG_ZMK_USB=y
CONFIG_MPU_ALLOW_FLASH_WRITE=y
CONFIG_NVS=y
CONFIG_SETTINGS_NVS=y
CONFIG_FLASH=y
CONFIG_FLASH_PAGE_LAYOUT=y
CONFIG_FLASH_MAP=y
CONFIG_BUILD_OUTPUT_UF2=y
```

## config/boards/shields/sweep/Kconfig.defconfig
```kconfig
if BOARD_NRF52840_MDK_USB_DONGLE

# The board's UF2 and settings defaults are supplied by the user config.
config ZMK_BOARD_COMPAT
	default y

endif

if SHIELD_SWEEP_DONGLE

config ZMK_KEYBOARD_NAME
	default "Sweep"

config ZMK_SPLIT_ROLE_CENTRAL
	default y

config ZMK_USB
	default y

endif

if SHIELD_SWEEP_LEFT

config ZMK_SPLIT_ROLE_CENTRAL
	default y

endif

if SHIELD_SWEEP_LEFT || SHIELD_SWEEP_RIGHT || SHIELD_SWEEP_DONGLE

config ZMK_SPLIT
	default y

config ZMK_BLE
	default y

endif
```

## config/west.yml
```yaml
manifest:
  remotes:
    - name: zmkfirmware
      url-base: https://github.com/newx-it
  projects:
    - name: zmk
      remote: zmkfirmware
      revision: feat-ble-prevent-sleep-feat-usb-allow-sleep
      import: app/west.yml
  self:
    path: config
```
