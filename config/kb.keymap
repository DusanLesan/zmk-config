#include <behaviors.dtsi>
#include <dt-bindings/zmk/bt.h>
#include <dt-bindings/zmk/keys.h>
#include "50.h"

#define KEYS_L 0 1 2 3 4 5 12 13 14 15 16 17 24 25 26 27 28 29 30 31
#define KEYS_R 6 7 8 9 10 11 18 19 20 21 22 23 32 33 34 35 36 37 38 39
#define THUMBS 40 41 42 43 44 45 46 47 48 49

#include "common.dtsi"

#define BINDINGS(PREFIX, NAME, TL, TR, HL, HR, BL, BC1, BC2, BC3, BC4, BR, THL1, THL2, THL3, THR1, THR2, THR3) \
	NAME { \
		bindings = < \
			TL PREFIX##_TOP_ROW_L                       PREFIX##_TOP_ROW_R TR \
			HL PREFIX##_HOME_ROW_L                     PREFIX##_HOME_ROW_R HR \
			BL PREFIX##_BOTTOM_ROW_L BC1 BC2 BC3 BC4 PREFIX##_BOTTOM_ROW_R BR \
			THL1 THL2 THL3          PREFIX##_THUMB_ROW         THR1 THR2 THR3 \
		>; \
	}

/ {
	keymap {
		compatible = "zmk,keymap";

		BINDINGS(A, alpha, &kp ESC, &bc_del, &kp TAB, &kp SQT,
			&kp CAPS, &kp K_FORWARD, &kp LSHFT, &kp K_FORWARD, &kp K_BACK, &kp BSLH,
			&kp LCTRL, &kp LALT, &kp LGUI, &kp RGUI, &kp RIGHT_ALT, &kp K_MENU);

		BINDINGS(N, num, &trans, &trans, &trans, &trans, &trans, &trans, &trans, &trans, &trans, &trans, &trans, &trans, &trans, &trans, &trans, &trans);
		BINDINGS(M, nav, &trans, &trans, &trans, &trans, &trans, &trans, &trans, &trans, &trans, &trans, &trans, &trans, &trans, &trans, &trans, &trans);
		BINDINGS(F, funct, &trans, &trans, &trans, &trans, &trans, &trans, &trans, &trans, &trans, &trans, &trans, &trans, &trans, &trans, &trans, &trans);
	};
};
