#include <behaviors.dtsi>
#include <dt-bindings/zmk/keys.h>
#include <dt-bindings/zmk/bt.h>
#include <behaviors/num_word.dtsi>
#include "34.h"

#define KEYS_L 0 1 2 3 4 10 11 12 13 14 20 21 22 23 24
#define KEYS_R 5 6 7 8 9 15 16 17 18 19 25 26 27 28 29
#define THUMBS 30 31 32 33

#include "common.dtsi"

#define BINDINGS(PREFIX, NAME) \
	NAME { \
		bindings = < \
			PREFIX##_TOP_ROW_L     PREFIX##_TOP_ROW_R \
			PREFIX##_HOME_ROW_L    PREFIX##_HOME_ROW_R \
			PREFIX##_BOTTOM_ROW_L  PREFIX##_BOTTOM_ROW_R \
			PREFIX##_THUMB_ROW \
		>; \
	}

/ {
	keymap {
		compatible = "zmk,keymap";
		BINDINGS(A, alpha);
		BINDINGS(N, num);
		BINDINGS(M, nav);
		BINDINGS(F, funct);
		BINDINGS(S, sr);
	};
};
