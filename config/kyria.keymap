#include <behaviors.dtsi>
#include <dt-bindings/zmk/bt.h>
#include <dt-bindings/zmk/keys.h>
#include <behaviors/num_word.dtsi>

#define ALP 0
#define NUM 1
#define NAV 2
#define FUN 3
#define GAM 4

#define KEYS_L 0 1 2 3 4 5 12 13 14 15 16 17 24 25 26 27 28 29 30 31
#define KEYS_R 6 7 8 9 10 11 18 19 20 21 22 23 32 33 34 35 36 37 38 39
#define THUMBS 40 41 42 43 44 45 46 47 48 49

&num_word {
	continue-list = <BSPC DEL DOT COMMA>;
};

&lt {
	tapping-term-ms = <300>;
	flavor = "hold-preferred";
};

#define MOD_MORPH(bind1, bind2) \
	compatible = "zmk,behavior-mod-morph"; \
	#binding-cells = <0>; \
	mods = <(MOD_LSFT|MOD_RSFT)>; \
	bindings = <bind1>, <bind2>;

#define HOLD_TAP(tap, hold) \
	compatible = "zmk,behavior-hold-tap"; \
	flavor = "balanced"; \
	bindings = <tap>, <hold>; \
	#binding-cells = <2>; \
	tapping-term-ms = <280>;

#define HOME_ROW \
	hold-trigger-on-release; \
	quick-tap-ms = <175>; \
	require-prior-idle-ms = <150>; \

/ {
	behaviors {
		bc_del: bc_del { label = "BC_DEL"; MOD_MORPH(&kp BACKSPACE, &kp DELETE) };
		lpar_lt: lpar_lt { label = "LPAR_LT"; MOD_MORPH(&kp LPAR, &kp LT) };
		rpar_gt: rpar_gt { label = "RPAR_GT"; MOD_MORPH(&kp RPAR, &kp GT) };

		td_num: td_num {
			compatible = "zmk,behavior-tap-dance";
			#binding-cells = <0>;
			tapping-term-ms = <200>;
			bindings = <&num_word NUM>, <&sl NUM>;
		};

		lt_num: lt_num {
			label = "LT_NUM";
			HOLD_TAP(&mo, &td_num)
		};

		l_tap: layer_tap {
			HOLD_TAP(&mo, &to)
		};

		hml: hml { label = "HML"; hold-trigger-key-positions = <KEYS_R THUMBS>; HOME_ROW HOLD_TAP(&kp, &kp) };
		hmr: hmr { label = "HMR"; hold-trigger-key-positions = <KEYS_L THUMBS>; HOME_ROW HOLD_TAP(&kp, &kp) };
		hr_combo_lpar: hr_combo_lpar { hold-trigger-key-positions = <KEYS_L THUMBS>; HOME_ROW HOLD_TAP(&kp, &lpar_lt) };
		hr_combo_rpar: hr_combo_rpar { hold-trigger-key-positions = <KEYS_L THUMBS>; HOME_ROW HOLD_TAP(&kp, &rpar_gt) };
	};

	combos {
		compatible = "zmk,combos";
		excl { bindings = <&kp EXCL>; key-positions = <1 13>; };
		at { bindings = <&kp AT>; key-positions = <2 14>; };
		pound { bindings = <&kp POUND>; key-positions = <3 15>; };
		dollar { bindings = <&kp DOLLAR>; key-positions = <4 16>; };
		percent { bindings = <&kp PERCENT>; key-positions = <5 17>; };
		caret { bindings = <&kp CARET>; key-positions = <6 18>; };
		plus { bindings = <&kp PLUS>; key-positions = <7 19>; };
		astrk { bindings = <&kp ASTRK>; key-positions = <8 20>; };
		amps { bindings = <&kp AMPS>; key-positions = <9 21>; };
		slsh { bindings = <&kp SLASH>; key-positions = <20 36>; };
		lbrc {bindings = <&kp LEFT_BRACKET>; key-positions = <35 36>; };
		rbrc { bindings = <&kp RIGHT_BRACKET>; key-positions = <36 37>; };
		dash { bindings = <&kp MINUS>; key-positions = <19 35>; };
		equal { bindings = <&kp EQUAL>; key-positions = <16 28>; };
		tild { bindings = <&kp GRAVE>; key-positions = <13 25>; };
		bslh { bindings = <&kp BSLH>; key-positions = <15 27>; };
		pipe { bindings = <&kp PIPE>; key-positions = <21 37>; };

		lpar { timeout-ms = <18>; bindings = <&hr_combo_lpar RS(RCTRL) 0>; key-positions = <19 20>; layers = <ALP NUM>; require-prior-idle-ms = <150>; };
		rpar { timeout-ms = <18>; bindings = <&hr_combo_rpar RS(RALT) 0>; key-positions = <20 21>; layers = <ALP NUM>; require-prior-idle-ms = <150>; };
	};

	keymap {
		compatible = "zmk,keymap";

		alpha {
			bindings = <
&kp ESC   &kp Q        &kp W        &kp E         &kp R         &kp T                                                                         &kp Y     &kp U          &kp I         &kp O        &kp P           &bc_del
&kp TAB   &hml LGUI A  &hml LALT S  &hml LSHFT D  &hml LCTRL F  &hml LGUI G                                                                   &kp H     &hmr RCTRL J   &hmr RSHFT K  &hmr RALT L  &hmr RGUI SEMI  &kp SQT
&kp CAPS  &kp Z        &kp X        &kp C         &kp V         &kp B        &kp K_FORWARD    &kp LSHFT        &l_tap FUN FUN  &kp K_BACK     &kp N     &kp M          &kp COMMA     &kp DOT      &kp FSLH        &kp BACKSLASH
									&kp LCTRL     &kp LALT      &kp LGUI     &mt LCTRL SPACE  &lt NAV SPACE    &mt RSHFT ENTER &lt_num NUM 0  &kp RGUI  &kp RIGHT_ALT  &kp K_MENU
			>;
		};

		num {
			bindings = <
&trans  &trans  &kp N7  &kp N8  &kp N9  &trans                                     &trans  &trans  &trans &trans  &trans  &trans
&trans  &trans  &kp N4  &kp N5  &kp N6  &trans                                     &trans  &trans  &trans &trans  &trans  &trans
&trans  &kp N0  &kp N1  &kp N2  &kp N3  &trans  &trans  &trans     &trans  &trans  &trans  &trans  &trans &trans  &trans  &trans
						&trans  &trans  &trans  &trans  &trans     &trans  &trans  &trans  &trans  &trans
			>;
		};

		nav {
			bindings = <
&trans  &trans  &trans  &trans  &trans  &trans                                      &kp PG_UP      &kp HOME    &kp UP_ARROW    &kp END     &kp C_VOLUME_UP  &kp DELETE
&trans  &trans  &trans  &trans  &trans  &trans                                      &kp PAGE_DOWN  &kp LEFT    &kp DOWN        &kp RIGHT   &kp C_VOL_DN     &kp INSERT
&trans  &trans  &trans  &trans  &trans  &trans  &trans  &trans      &trans  &trans  &trans         &trans      &trans          &trans      &trans           &kp PRINTSCREEN
						&trans  &trans  &trans  &trans  &to ALP     &trans  &trans  &trans         &trans      &trans
			>;
		};

		funct {
			bindings = <
&trans  &kp F12  &kp F7  &kp F8  &kp F9  &trans                                       &bt BT_SEL 0  &bt BT_SEL 1  &bt BT_SEL 2    &bt BT_SEL 3  &bt BT_SEL 4  &bt BT_CLR
&trans  &kp F11  &kp F4  &kp F5  &kp F6  &trans                                       &trans        &trans        &trans          &trans        &trans        &trans
&trans  &kp F10  &kp F1  &kp F2  &kp F3  &trans  &trans  &trans     &to ALP &to GAM   &kp C_PLAY    &kp C_STOP    &kp C_PREVIOUS  &kp C_NEXT    &kp C_MUTE    &trans
						 &trans  &trans  &trans  &trans  &trans     &trans  &trans    &trans        &trans        &trans          &trans
			>;
		};

		game {
			bindings = <
&trans  &trans  &kp Q  &kp W   &kp E   &kp R                                   &trans  &trans  &trans  &trans  &trans  &trans
&trans  &trans  &kp A  &kp S   &kp D   &kp F                                   &trans  &trans  &trans  &trans  &trans  &trans
&tog 0  &trans  &kp Z  &kp X   &kp C   &kp V   &kp G   &kp I      &trans  &trans  &trans  &trans  &trans  &trans  &trans  &tog ALP
					   &trans  &trans  &trans  &trans  &trans     &trans  &trans  &trans  &trans  &trans
			>;
		};
	};
};
